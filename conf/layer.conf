## conf/layer.conf
```bitbake
# We have a conf and classes directory, append to BBPATH
BBPATH .= ":${LAYERDIR}"

# We have a recipes directory, add to BBFILES
BBFILES += "${LAYERDIR}/recipes-*/*/*.bb ${LAYERDIR}/recipes-*/*/*.bbappend"

BBFILE_COLLECTIONS += "testing-layer"
BBFILE_PATTERN_testing-layer := "^${LAYERDIR}/"
BBFILE_PRIORITY_testing-layer = "7"

LAYERVERSION_testing-layer = "1"
```
